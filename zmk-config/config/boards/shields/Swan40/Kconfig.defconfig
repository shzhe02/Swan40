## zmk-config/config/boards/shields/Swan40/Kconfig.defconfig
```kconfig
if SHIELD_SWAN40_LEFT

config ZMK_KEYBOARD_NAME
    default "Swan40"

config ZMK_SPLIT_ROLE_CENTRAL
    default y

endif

if SHIELD_SWAN40_LEFT || SHIELD_SWAN40_RIGHT

config ZMK_SPLIT
    default y

endif
```

## zmk-config/config/boards/shields/Swan40/Kconfig.shield
```kconfig
config SHIELD_SWAN40_LEFT
	def_bool $(shields_list_contains,swan40_left)

config SHIELD_SWAN40_RIGHT
	def_bool $(shields_list_contains,swan40_right)
```
